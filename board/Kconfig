## board/Kconfig
```kconfig
menu "Board Support"
	config BOARD_AMAZON
		bool "Support for Amazon boards"
		default n
		help
		  Say Y if you want to include support for Amazon boards

	config BOARD_APPLE
		bool "Support for Apple boards"
		default n
		help
		  Say Y if you want to include support for Apple boards

	config BOARD_GOOGLE
		bool "Support for Google boards"
		default n
		help
		  Say Y if you want to include support for Google boards

	config BOARD_HONOR
		bool "Support for Honor boards"
		default n
		help
		  Say Y if you want to include support for Honor boards

	config BOARD_HUAWEI
		bool "Support for Huawei boards"
		default n
		help
		  Say Y if you want to include support for Huawei boards

	config BOARD_INFINIX
		bool "Support for Infinix boards"
		default n
		help
		  Say Y if you want to include support for Infinix boards

	config BOARD_ITEL
		bool "Support for Itel boards"
		default n
		help
		  Say Y if you want to include support for Itel boards

	config BOARD_NOKIA
		bool "Support for Nokia boards"
		default n
		help
		  Say Y if you want to include support for Nokia boards

	config BOARD_NOTHING
		bool "Support for Nothing boards"
		default n
		help
		  Say Y if you want to include support for Nothing boards

	config BOARD_QEMU
		bool "Support for QEMU boards"
		default n
		help
		  Say Y if you want to include support for QEMU boards

	config BOARD_SAMSUNG
		bool "Support for Samsung boards"
		default n
		help
		  Say Y if you want to include support for Samsung boards

	config BOARD_VOLLA
		bool "Support for Volla boards"
		default n
		help
		  Say Y if you want to include support for Volla boards

	config BOARD_XIAOMI
		bool "Support for Xiaomi boards"
		default n
		help
		  Say Y if you want to include support for Xiaomi boards
endmenu

source "board/Kconfig.boards"

menu "Board Specific Addresses"
	config TEXT_BASE
		hex "UniLoader Text Base"
		default 0x0

	config PAYLOAD_ENTRY
		hex "Payload Entry Address"
		default 0x50000000 if NOTHING_TETRIS
		default 0x050000000 if SAMSUNG_J4LTE
		default 0x60000000 if VOLLA_ALGIZ
		default 0x50000000 if XIAOMI_BEGONIA

	config RAMDISK_ENTRY
		hex "Ramdisk Entry Address"
		default 0x40000000 if NOTHING_TETRIS
		default 0x51100000 if VOLLA_ALGIZ
		default 0x48000000 if XIAOMI_BEGONIA
endmenu
```

## board/Kconfig.boards
```kconfig
source "board/amazon/Kconfig"

source "board/apple/Kconfig"

source "board/google/Kconfig"

source "board/huawei/Kconfig"

source "board/infinix/Kconfig"

source "board/itel/Kconfig"

source "board/nokia/Kconfig"

source "board/nothing/Kconfig"

source "board/qemu/Kconfig"

source "board/samsung/Kconfig"

source "board/volla/Kconfig"

source "board/xiaomi/Kconfig"
```

## board/amazon/Kconfig
```kconfig
menu "Amazon board Support"
	config AMAZON_PW3
		bool "Support for Amazon Kindle Paperwhite 3"
		default n
		depends on FREESCALE_IMX6SL
		select BOARD_AMAZON
		help
		  Say Y if you want to include support for Amazon Kindle
		  Paperwhite 3
endmenu
```

## board/apple/Kconfig
```kconfig
menu "Apple board Support"
	config APPLE_N61AP
		bool "Support for Apple iPhone 6"
		default n
		depends on APPLE_T7000
		select BOARD_APPLE
		help
		  Say Y if you want to include support for iPhone 6
endmenu
```

## board/google/Kconfig
```kconfig
menu "Google board Support"
	config GOOGLE_TAIMEN
		bool "Support for Google Pixel 2 XL"
		default n
		depends on MSM8998
		select BOARD_GOOGLE
		help
		  Say Y if you want to include support for Pixel 2 XL
endmenu
```

## board/honor/Kconfig
```kconfig
menu "Honor board Support"
	config HONOR_STANFORD
		bool "Support for Honor 9"
		default n
		depends on HI3660
		select BOARD_HONOR
		help
		  Say Y if you want to include support for Honor 9
endmenu
```

## board/huawei/Kconfig
```kconfig
menu "Huawei board Support"
	config HUAWEI_AGASSI2
		bool "Support for Huawei Mediapad T5"
		default n
		depends on HI6250
		select BOARD_HUAWEI
		help
		  Say Y if you want to include support for Huawei Mediapad T5

	config HUAWEI_VICTORIA
		bool "Support for Huawei P10"
		default n
		depends on HI3660
		select BOARD_HUAWEI
		help
		  Say Y if you want to include support for Huawei P10
endmenu
```

## board/infinix/Kconfig
```kconfig
menu "Infinix board Support"
	config INFINIX_X6710
		bool "Support for Infinix Note 30 VIP"
		default n
		depends on MT6893
		select BOARD_INFINIX
		help
		  Say Y if you want to include support for Infinix Note 30 VIP
endmenu
```

## board/itel/Kconfig
```kconfig
menu "Itel board Support"
	config ITEL_P682LPN
		bool "Support for itel Vision 3 Plus"
		default n
		depends on UMS9230
		select BOARD_ITEL
		help
		  Say Y if you want to include support for itel Vision 3 Plus
endmenu
```

## board/nokia/Kconfig
```kconfig
menu "Nokia board Support"
	config NOKIA_ESSENTIAL
		bool "Support for Nokia 3"
		default n
		depends on MT6735
		select BOARD_NOKIA
		help
		  Say Y if you want to include support for Nokia 3
endmenu
```

## board/nothing/Kconfig
```kconfig
menu "Nothing board Support"
	config NOTHING_TETRIS
		bool "Support for CMF Phone 1"
		default n
		depends on MT6878
		select BOARD_NOTHING
		help
		  Say Y if you want to include support for CMF Phone 1

	config NOTHING_TETRIS_DISABLE_WDT
		bool "Disable the watchdog timer on startup"
		default y
		depends on NOTHING_TETRIS
		help
		  Say Y if you want to disable the watchdog timer on startup
		  on this board. While this is obviously useful for end-users,
		  developers may want to leave this on to avoid holding down
		  the power button every time.
endmenu
```

## board/qemu/Kconfig
```kconfig
menu "Qemu board Support"
	config QEMU_BOARD_VIRT
		bool "Support for QEMU virt platform (aarch64)"
		default n
		depends on QEMU_SOC_VIRT
		select BOARD_QEMU
		help
		  Say Y if you are using the generic QEMU emulation
		  platform target - virt.
endmenu
```

## board/samsung/Kconfig
```kconfig
menu "Samsung board Support"
	config SAMSUNG_A105F
		bool "Support for Samsung Galaxy A10"
		default n
		depends on EXYNOS_7885
		select BOARD_SAMSUNG
		help
		   Say Y if you want to include support for Samsung Galaxy A10

	config SAMSUNG_A127F
		bool "Support for Samsung Galaxy A12 Nacho"
		default n
		depends on EXYNOS_3830
		select BOARD_SAMSUNG
		help
		  Say Y if you want to include support for Samsung Galaxy A12 Nacho

	config SAMSUNG_A305F
		bool "Support for Samsung Galaxy A30"
		default n
		depends on EXYNOS_7885
		select BOARD_SAMSUNG
		help
		   Say Y if you want to include support for Samsung Galaxy A30

	config SAMSUNG_A336B
		bool "Support for Samsung Galaxy A33"
		default n
		depends on EXYNOS_1280
		select BOARD_SAMSUNG
		help
		  Say Y if you want to include support for Samsung Galaxy A33

	config SAMSUNG_A3XELTE
		bool "Support for Samsung Galaxy A3 2016"
		default n
		depends on EXYNOS_7580
		select BOARD_SAMSUNG
		help
		  Say Y if you want to include support for Samsung Galaxy A3 2016

	config SAMSUNG_BEYOND1LTE
		bool "Support for Samsung Galaxy S10"
		default n
		depends on EXYNOS_9820
		select BOARD_SAMSUNG
		help
		  Say Y if you want to include support for Samsung Galaxy S10

	config SAMSUNG_C1S
		bool "Support for Samsung Galaxy Note 20"
		default n
		depends on EXYNOS_990
		select BOARD_SAMSUNG
		help
		  Say Y if you want to include support for Samsung Galaxy Note 20

	config SAMSUNG_DREAMLTE
		bool "Support for Samsung Galaxy S8"
		default n
		depends on EXYNOS_8895
		select BOARD_SAMSUNG
		help
		  Say Y if you want to include support for Samsung Galaxy S8

	config SAMSUNG_G0S
		bool "Support for Samsung Galaxy S22+"
		default n
		depends on EXYNOS_2200
		select BOARD_SAMSUNG
		help
		  Say Y if you want to include support for Samsung Galaxy S22+

	config SAMSUNG_GTA4XL
		bool "Support for Samsung Galaxy Tab S6 Lite"
		default n
		depends on EXYNOS_9610
		select BOARD_SAMSUNG
		help
		  Say Y if you want to include support for Samsung Galaxy Tab S6 Lite

	config SAMSUNG_HEROLTE
		bool "Support for Samsung Galaxy S7"
		default n
		depends on EXYNOS_8890
		select BOARD_SAMSUNG
		help
		  Say Y if you want to include support for Samsung Galaxy S7

	config SAMSUNG_J4LTE
		bool "Support for Samsung Galaxy J4 2018"
		default n
		depends on EXYNOS_7570
		select BOARD_SAMSUNG
		help
		  Say Y if you want to include arm64 support for Samsung Galaxy J4 2018

	config SAMSUNG_J5LTE
		bool "Support for Samsung Galaxy J5 2015"
		default n
		depends on QC32_8916
		select BOARD_SAMSUNG
		help
		  Say Y if you want to include arm32 support for Samsung Galaxy J5 2015

	config SAMSUNG_JACKPOTLTE
		bool "Support for Samsung Galaxy A8 (2018)"
		default n
		depends on EXYNOS_7885
		select BOARD_SAMSUNG
		help
		  Say Y if you want to include support for Samsung Galaxy A8 (2018)

	config SAMSUNG_NOBLELTE
		bool "Support for Samsung Galaxy Note5"
		default n
		depends on EXYNOS_7420
		select BOARD_SAMSUNG
		help
		  Say Y if you want to include support for Samsung Galaxy Note 5

	config SAMSUNG_R0Q
		bool "Support for Samsung Galaxy S22"
		default n
		depends on SM8450
		select BOARD_SAMSUNG
		help
		  Say Y if you want to include support for Samsung Galaxy S22

	config SAMSUNG_R8S
		bool "Support for Samsung Galaxy S20 FE"
		default n
		depends on EXYNOS_990
		select BOARD_SAMSUNG
		help
		  Say Y if you want to include support for Samsung Galaxy S20 FE

	config SAMSUNG_STARLTE
		bool "Support for Samsung Galaxy S9"
		default n
		depends on EXYNOS_9810
		select BOARD_SAMSUNG
		help
		  Say Y if you want to include support for Samsung Galaxy S9

	config SAMSUNG_X1S
		bool "Support for Samsung Galaxy S20"
		default n
		depends on EXYNOS_990
		select BOARD_SAMSUNG
		help
		  Say Y if you want to include support for Samsung Galaxy S20

	config SAMSUNG_ZEROFLTE
		bool "Support for Samsung Galaxy S6"
		default n
		depends on EXYNOS_7420
		select BOARD_SAMSUNG
		help
		  Say Y if you want to include support for Samsung Galaxy S6
endmenu
```

## board/volla/Kconfig
```kconfig
menu "Volla board Support"
	config VOLLA_ALGIZ
		bool "Support for Volla Phone Quintus"
		default n
		depends on MT6877
		select BOARD_VOLLA
		help
		  Say Y if you want to include support for Volla Phone Quintus
endmenu
```

## board/xiaomi/Kconfig
```kconfig
menu "Xiaomi board Support"
	config XIAOMI_BEGONIA
		bool "Support for Redmi Note 8 Pro"
		default n
		depends on MT6785
		select BOARD_XIAOMI
		help
		  Say Y if you want to include support for Redmi Note 8 Pro

	config XIAOMI_BLOSSOM
		bool "Support for Xiaomi Blossom devices"
		default n
		depends on MT6765
		select BOARD_XIAOMI
		help
		  Say Y if you want to include support for Xiaomi Blossom
		  devices (R Vendor only):
		  Redmi 9A, Redmi 9I, Redmi 9AT, Redmi 10A, Redmi 9A Sport, Redmi 9I Sport,
		  Poco C3, Poco C31, Redmi 9C, Redmi 9C NFC, Redmi 9 India, Redmi 9 Active.

	config XIAOMI_CAMELLIA
		bool "Support for Xiaomi Poco M3 Pro 5G"
		default n
		depends on MT6833
		select BOARD_XIAOMI
		help
		  Say Y if you want to include support for Poco M3 Pro 5G
endmenu
```

## configs/a105f_defconfig
```kconfig
CONFIG_EXYNOS_7885=y
CONFIG_SAMSUNG_A105F=y
CONFIG_PAYLOAD_ENTRY=0x90000000
CONFIG_RAMDISK_ENTRY=0x84000000
```

## configs/a127f_defconfig
```kconfig
CONFIG_EXYNOS_3830=y
CONFIG_SAMSUNG_A127F=y
CONFIG_PAYLOAD_ENTRY=0x90008000
CONFIG_RAMDISK_ENTRY=0x82000000
```

## configs/a336b_defconfig
```kconfig
CONFIG_EXYNOS_1280=y
CONFIG_SAMSUNG_A336B=y
CONFIG_PAYLOAD_ENTRY=0x90000000
CONFIG_RAMDISK_ENTRY=0x84000000
```

## configs/anne_defconfig
```kconfig
CONFIG_RAMDISK_NO_COPY=y
CONFIG_FDT_BUF_SIZE=600000
CONFIG_HI6250=y
CONFIG_HUAWEI_ANNE=y
CONFIG_TEXT_BASE=0x00480000
CONFIG_PAYLOAD_ENTRY=0x100000000
CONFIG_RAMDISK_ENTRY=0x44000000
```

## configs/blossom_defconfig
```kconfig
CONFIG_UART_DEBUG=y
CONFIG_MT6765=y
CONFIG_XIAOMI_BLOSSOM=y
CONFIG_TEXT_BASE=0x40080000
CONFIG_PAYLOAD_ENTRY=0x60000000
CONFIG_RAMDISK_ENTRY=0x51100000
```

## configs/camellia_defconfig
```kconfig
CONFIG_UART_DEBUG=y
CONFIG_MT6833=y
CONFIG_XIAOMI_CAMELLIA=y
CONFIG_TEXT_BASE=0x40080000
CONFIG_PAYLOAD_ENTRY=0x60000000
CONFIG_RAMDISK_ENTRY=0x51100000
```

## configs/n61ap_defconfig
```kconfig
CONFIG_APPLE_N61AP=y
CONFIG_PAYLOAD_ENTRY=0x830000000
CONFIG_RAMDISK_ENTRY=0x835000000
```

## configs/noblelte_defconfig
```kconfig
CONFIG_POSITION_INDEPENDENT=y
CONFIG_EXYNOS_7420=y
CONFIG_SAMSUNG_NOBLELTE=y
CONFIG_TEXT_BASE=0x47000000
CONFIG_PAYLOAD_ENTRY=0x50000000
CONFIG_RAMDISK_ENTRY=0x44000000
```

## configs/pw3_defconfig
```kconfig
# CONFIG_SIMPLE_FB is not set
CONFIG_UART_DEBUG=y
CONFIG_FREESCALE_IMX6SL=y
CONFIG_AMAZON_PW3=y
CONFIG_TEXT_BASE=0x82000000
CONFIG_PAYLOAD_ENTRY=0x90000000
CONFIG_RAMDISK_ENTRY=0x87000000
```

## configs/stanford_defconfig
```kconfig
CONFIG_RAMDISK_NO_COPY=n
CONFIG_FDT_BUF_SIZE=600000
CONFIG_HI3660=y
CONFIG_HONOR_STANFORD=y
CONFIG_TEXT_BASE=0x00080000
CONFIG_PAYLOAD_ENTRY=0x200000000
CONFIG_RAMDISK_ENTRY=0x07c00000
```
