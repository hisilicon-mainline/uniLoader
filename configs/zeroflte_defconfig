## configs/zeroflte_defconfig
```kconfig
CONFIG_POSITION_INDEPENDENT=y
CONFIG_EXYNOS_7420=y
CONFIG_SAMSUNG_ZEROFLTE=y
CONFIG_TEXT_BASE=0x47000000
CONFIG_PAYLOAD_ENTRY=0x90000000
CONFIG_RAMDISK_ENTRY=0x44000000
```

## drivers/uart/Kconfig
```kconfig
if UART_DEBUG
config UART_IMX
	bool "Support for IMX UART"
	default FREESCALE
	help
	    Say Y if you have a device with the IMX UART.

config UART_MTK
	bool "Support for MediaTek UART"
	default MEDIATEK
	help
	    Say Y if you have a device with the MediaTek UART.

config UART_VIRT
	bool "Support for Virt (QEMU) UART"
	default QEMU
	help
	    Say Y if you have a device with the QEMU UART

config UART_QCOM
	bool "Support for Qualcomm UART"
	default QUALCOMM
	help
	    Say Y if you have a device with the Qualcomm UART.
endif
```
